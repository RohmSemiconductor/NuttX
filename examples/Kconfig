## examples/bluetooth/Kconfig
```kconfig
#
# For a description of the syntax of this configuration file,
# see the file kconfig-language.txt in the NuttX tools repository.
#

config EXAMPLES_BLE
	bool "Bluetooth LE example"
	default n
	---help---
		Enable the bluetooth example

if EXAMPLES_BLE

config EXAMPLES_BLE_PROGNAME
	string "Program name"
	default "bluetooth"
	depends on BUILD_KERNEL
	---help---
		This is the name of the program that will be use when the NSH ELF
		program is installed.

config EXAMPLES_BLE_PRIORITY
	int "Bluetooth task priority"
	default 100

config EXAMPLES_BLE_STACKSIZE
	int "Bluetooth example stack size"
	default 2048

endif
```

## examples/halleffect/Kconfig
```kconfig
#
# For a description of the syntax of this configuration file,
# see the file kconfig-language.txt in the NuttX tools repository.
#

config EXAMPLES_HALLEFFECT
	bool "Hall effect sensor example"
	default n
	---help---
		Enable the sensor via SCU example

if EXAMPLES_HALLEFFECT

config EXAMPLES_HALLEFFECT_PROGNAME
	string "Program name"
	default "halleffect"
	depends on BUILD_KERNEL
	---help---
		This is the name of the program that will be use when the NSH ELF
		program is installed.

config EXAMPLES_HALLEFFECT_PRIORITY
	int "Sensor task priority"
	default 100

config EXAMPLES_HALLEFFECT_STACKSIZE
	int "Sensor stack size"
	default 2048

config EXAMPLES_HALLEFFECT_DEVNAME
    string "Hall effect sensor device name"
    default "/dev/halle0"

config EXAMPLES_HALLEFFECT_SIGNO
    int "Hall effect sensor signal"
    default 14

endif
```
